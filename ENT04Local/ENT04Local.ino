/*
   IRremoteESP8266: IRsendGCDemo - demonstrates sending Global Cache-formatted IR codes with IRsend
   An IR LED must be connected to ESP8266 pin 0.
   Version 0.1 30 March, 2016
   Based on Ken Shirriff's IrsendDemo Version 0.1 July, 2009, Copyright 2009 Ken Shirriff, http://arcfn.com
*/

//********** Inclue lib ******************************
#include <IRremoteESP8266.h>
#include <ESP8266WiFi.h>
#include <WiFiClient.h>
#include <ESP8266HTTPClient.h>
#include <ESP8266WebServer.h>
//#include <WebSocketsServer.h>
#include <ESP8266mDNS.h>
#include <FS.h>
#include <ESP8266HTTPUpdateServer.h>

//********** Network Setting *******************
const char* ssid = "YYap";
const char* password = "1111111111";
const char* host = "ent04";
IPAddress ip(192, 168, 1, 114); //Node static IP
IPAddress gateway(192, 168, 1, 1);
IPAddress subnet(255, 255, 255, 0);
const char* entity = "ENT04";
const char* serverIP = "192.168.1.168";
String line = ""; // Deep sleep

//*********** Alias Name ************************
WiFiClient client;
HTTPClient http;
ESP8266WebServer server(80);
ESP8266HTTPUpdateServer httpUpdater;
//WebSocketsServer webSocket = WebSocketsServer(81);
File fsUploadFile;

//************ ESP8266 Pin Definition **********************
IRsend irsend(5); //an IR emitter led is connected to GPIO pin 5


// Codes are in Global Cache format less the emitter ID and request ID. These codes can be found in GC's Control Tower database.
unsigned int  rawDown[67] = {9200, 4300, 750, 400, 750, 400, 750, 400, 750, 400, 750, 400, 750,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 1600, 700}; // NEC FF38C7
unsigned int  rawUp[67] = {9150, 4300, 750, 450, 800, 350, 850, 350, 750, 400, 800, 350, 800,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 1550, 700}; // NEC FF18E7
unsigned int  rawMute[67] = {9150, 4350, 750, 400, 750, 400, 800, 400, 800, 400, 750, 450, 750,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 1550, 700}; // NEC FF08F7
unsigned int  rawLeft[67] = {9200, 4300, 800, 400, 750, 400, 800, 400, 800, 400, 750, 450, 750,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 1550, 750}; // NEC FF9867
unsigned int  rawOK[67] = {9200, 4300, 800, 400, 800, 400, 800, 400, 750, 450, 800, 400, 750,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 1550, 750}; // NEC FF58A7
unsigned int  rawRight[67] = {9200, 4250, 750, 450, 700, 450, 750, 400, 750, 450, 750, 450, 700,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 1650, 650}; // NEC FFD827
unsigned int  rawPower[67] = {9200, 4250, 800, 350, 800, 400, 750, 400, 750, 400, 800, 400, 750,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 1550, 700}; // NEC FF50AF
unsigned int  rawPower1[67] = {9200, 4250, 750, 400, 750, 400, 750, 450, 750, 400, 800, 350, 700,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 1550, 700}; // NEC FF50AF

unsigned int  sanyoPower[67] = {9050,4500, 600,600, 550,650, 550,650, 600,1700, 550,1750, 550,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1750, 650};  // UNKNOWN 7B3C707B
unsigned int  sanyoPower1[67] = {9000,4550, 550,650, 600,600, 550,650, 550,1750, 550,1750, 650,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1650, 550};  // UNKNOWN 7B3C707B

unsigned int  sanyoAIRPower[99] = {3600,1500, 650,250, 650,250, 650,250, 600,300, 600,250, 650,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350, 500};  // UNKNOWN E9D1FB54
unsigned int  sanyoAIRPower1[99] = {3550,1550, 600,300, 650,250, 650,250, 600,300, 600,300, 650,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350, 550};  // UNKNOWN 3A413BBE


unsigned int  IBT12831[67] = {8950, 4500, 550, 650, 550, 650, 550, 650, 550, 600, 550, 650, 550,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 1700, 550}; // UNKNOWN 8AB3679B
unsigned int  IBT12832[67] = {8950, 4500, 550, 650, 550, 650, 550, 650, 550, 650, 550, 650, 550,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 1750, 550}; // UNKNOWN 12209C7B
unsigned int  IBT12833[67] = {8900, 4550, 550, 650, 550, 650, 550, 650, 550, 650, 550, 650, 550,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 1700, 550}; // UNKNOWN 305D6FF
unsigned int  IBT12834[67] = {8950, 4500, 550, 650, 550, 650, 550, 650, 550, 650, 550, 650, 550,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 1700, 550}; // UNKNOWN 51E43D1B
unsigned int  IBT12835[67] = {8950, 4500, 550, 650, 550, 600, 550, 650, 550, 650, 550, 650, 550,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 1700, 550}; // UNKNOWN AB91951F
unsigned int  IBT12836[67] = {8950, 4500, 550, 650, 550, 600, 550, 650, 550, 600, 550, 650, 550,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 1700, 550}; // UNKNOWN FF9186B7
unsigned int  IBT12837[67] = {8900, 4550, 550, 650, 550, 650, 550, 650, 550, 650, 550, 650, 550,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 1700, 550}; // UNKNOWN F076C13B
unsigned int  IBT12838[67] = {8900, 4550, 550, 650, 550, 650, 550, 650, 550, 650, 550, 650, 550,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 1700, 550}; // UNKNOWN 8C22657B
unsigned int  IBT12839[67] = {8950, 4500, 550, 650, 550, 650, 550, 650, 550, 650, 550, 650, 550,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 1750, 550}; // UNKNOWN E5CFBD7F
unsigned int  IBT128310[67] = {8950, 4500, 550, 600, 550, 650, 550, 650, 550, 650, 550, 650, 550,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 1700, 550}; // UNKNOWN 9716BE3F
unsigned int  IBT12830[67] = {8950, 4500, 550, 650, 550, 600, 550, 650, 550, 650, 550, 650, 550,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 1700, 550}; // UNKNOWN FA3F159F
unsigned int  IBT128311[67] = {8950, 4500, 550, 650, 600, 600, 600, 600, 600, 600, 600, 600, 600,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 1700, 550}; // UNKNOWN 44C407DB

unsigned int  IBT1283Mute[67] = {8950, 4550, 550, 600, 550, 650, 550, 650, 550, 650, 550, 650, 550,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 1700, 550}; // UNKNOWN 45473C1B
unsigned int  IBT1283Stop[67] = {8950, 4500, 550, 650, 550, 600, 550, 650, 550, 650, 550, 600, 550,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 1700, 550}; // UNKNOWN 52A3D41F
unsigned int  IBT1283Play[67] = {8950, 4550, 550, 650, 550, 650, 550, 650, 550, 650, 550, 650, 550,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 1750, 550}; // UNKNOWN E318261B
unsigned int  IBT1283PreSect[67] = {8950, 4500, 550, 650, 550, 650, 550, 600, 550, 650, 550, 650, 550,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 1700, 550}; // UNKNOWN D7E84B1B
unsigned int  IBT1283Backward[67] = {8950, 4550, 550, 650, 550, 650, 550, 650, 550, 650, 550, 650, 550,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 1700, 550}; // UNKNOWN 3195A31F
unsigned int  IBT1283Forward[67] = {8950, 4550, 550, 650, 550, 650, 550, 650, 550, 650, 550, 650, 550,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 1750, 550}; // UNKNOWN 32C6FDF7
unsigned int  IBT1283Info[67] = {8950, 4550, 550, 650, 550, 650, 550, 650, 550, 650, 550, 650, 550,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 1700, 550}; // UNKNOWN 8A33665B
unsigned int  IBT1283Pause[67] = {8900, 4550, 550, 650, 550, 650, 550, 650, 550, 600, 550, 650, 550,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 1700, 550}; // UNKNOWN EE886D7F
unsigned int  IBT1283BackTo[67] = {8950, 4500, 550, 650, 550, 650, 550, 650, 550, 650, 550, 600, 550,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 1700, 550}; // UNKNOWN C101E57B
unsigned int  IBT1283Menu[67] = {8900, 4550, 550, 650, 550, 600, 550, 650, 550, 650, 550, 650, 550,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 1700, 550}; // UNKNOWN A6C4637B
unsigned int  IBT1283MultiAudio[67] = {8950, 4500, 550, 650, 550, 650, 550, 650, 550, 600, 550, 650, 550,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 1700, 550}; // UNKNOWN A8E05FBB
unsigned int  IBT1283Word[67] = {8950, 4550, 550, 650, 550, 650, 550, 650, 550, 650, 550, 650, 550,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 1750, 550}; // UNKNOWN 3954B1B7
unsigned int  IBT1283VolUp[67] = {8950, 4550, 550, 650, 550, 650, 550, 650, 550, 650, 550, 650, 550,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 1700, 550}; // UNKNOWN F377C5B7
unsigned int  IBT1283VolDown[67] = {8950, 4500, 550, 650, 550, 650, 550, 650, 550, 650, 550, 650, 550,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 1750, 550}; // UNKNOWN A3C8EDDB
unsigned int  IBT1283Home[67] = {8950, 4500, 550, 650, 550, 650, 550, 600, 550, 650, 550, 650, 550,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 1700, 550}; // UNKNOWN 8E5D3EBB
unsigned int  IBT1283DTVAV[67] = {8950, 4550, 550, 650, 550, 650, 550, 650, 550, 600, 550, 650, 550,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 1750, 550}; // UNKNOWN D538681B
unsigned int  IBT1283FactorySetup[67] = {8900, 4550, 550, 600, 550, 650, 550, 650, 550, 650, 550, 650, 550,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 1700, 550}; // UNKNOWN 9716BE3F
unsigned int  IBT1283Browser[67] = {8950, 4500, 550, 650, 550, 650, 550, 650, 550, 650, 550, 600, 550,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 1750, 550}; // UNKNOWN 44C407DB
unsigned int  IBT1283Program[67] = {8950, 4550, 550, 650, 550, 650, 550, 650, 550, 650, 550, 650, 550,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 1700, 550}; // UNKNOWN 930FFB7
unsigned int  IBT1283Channel[67] = {8950, 4550, 550, 650, 550, 650, 550, 650, 550, 650, 550, 650, 550,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 1700, 550}; // UNKNOWN 1BC0157B
unsigned int  IBT1283RecordList[67] = {8950, 4500, 550, 650, 550, 600, 550, 650, 550, 650, 550, 650, 550,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 1700, 550}; // UNKNOWN F0C41643
unsigned int  IBT1283TTX[67] = {8950, 4550, 550, 650, 550, 650, 550, 650, 550, 650, 550, 650, 550,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 1750, 550}; // UNKNOWN B5310E1F
unsigned int  IBT1283Zoomout[67] = {8900, 4550, 550, 650, 550, 650, 550, 650, 550, 650, 550, 650, 550,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 1700, 550}; // UNKNOWN 7EC31EF7
unsigned int  IBT1283Zoomin[67] = {8950, 4500, 550, 650, 550, 600, 550, 650, 550, 650, 550, 650, 550,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 1700, 550}; // UNKNOWN 9BFC1697
unsigned int  IBT1283Repeat[67] = {8950, 4500, 550, 600, 550, 650, 550, 600, 550, 650, 550, 650, 550,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 1700, 550}; // UNKNOWN EC213597
unsigned int  IBT1283RepratAB[67] = {8900, 4550, 550, 650, 550, 650, 550, 650, 550, 650, 550, 650, 550,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 1700, 550}; // UNKNOWN EE4ECCFB
unsigned int  IBT1283Resolution[67] = {8900, 4550, 550, 650, 550, 650, 550, 650, 550, 650, 550, 650, 550,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 1700, 550}; // UNKNOWN B953793F
unsigned int  IBT1283LRSpeaker[67] = {8950, 4500, 550, 650, 550, 650, 550, 650, 550, 650, 550, 650, 550,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 1750, 550}; // UNKNOWN B1A7211B
unsigned int  IBT1283Delete[67] = {8950, 4500, 550, 600, 550, 650, 550, 650, 550, 600, 550, 650, 550,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 1750, 550}; // UNKNOWN 9EF4941F
unsigned int  IBT1283Edit[67] = {8950, 4550, 550, 650, 550, 650, 550, 650, 550, 650, 550, 650, 550,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 1700, 550}; // UNKNOWN 5B83B61B

unsigned int  IBT1283Power[67] = {8950, 4500, 550, 650, 550, 600, 550, 600, 550, 600, 550, 650, 550,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 1700, 550}; // UNKNOWN 2A89195F
unsigned int  IBT1283PlayPause[67] = {8950, 4550, 550, 650, 550, 650, 550, 650, 550, 650, 550, 650, 550,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 1750, 550}; // UNKNOWN 511DBB
unsigned int  IBT1283NextSect[67] = {8900, 4550, 550, 600, 550, 650, 550, 650, 550, 650, 550, 600, 550,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 1700, 550}; // UNKNOWN 20FE4DBB
unsigned int  IBT1283Record[67] = {8950, 4550, 550, 600, 550, 650, 550, 650, 550, 650, 550, 650, 550,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 1700, 550}; // UNKNOWN 3EC3FC1B
unsigned int  IBT1283Right[67] = {8950, 4550, 550, 650, 550, 650, 550, 650, 550, 650, 550, 650, 550,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 1700, 550}; // UNKNOWN 86B0E697
unsigned int  IBT1283ViewAngel[67] = {8950, 4550, 550, 650, 550, 650, 550, 650, 550, 650, 550, 650, 550,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 1750, 550}; // UNKNOWN 449E79F
unsigned int  IBT1283ChanelUp[67] = {8950, 4500, 550, 650, 550, 650, 550, 650, 550, 600, 550, 650, 550,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 1750, 550}; // UNKNOWN 13549BDF
unsigned int  IBT1283ChanelDown[67] = {8900, 4550, 550, 650, 550, 650, 550, 650, 550, 650, 550, 650, 550,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 1700, 550}; // UNKNOWN 5BE75E7F


//******************Function  *****************************************
/*********** WebSocket & GPIO Control **************
  void webSocketEvent(uint8_t num, WStype_t type, uint8_t * payload, size_t lenght) {
  String text = String((char *) &payload[0]);
  char * textC = (char *) &payload[0];
  String rssi;
  String temp;
  int nr;
  int on;
  uint32_t rmask;
  int i;
  char b[10];   //declaring character array
  String str;  //declaring string
  static const uint32_t AFMapper[16] = {
    0, PERIPHS_IO_MUX_U0TXD_U, 0, PERIPHS_IO_MUX_U0RXD_U,
    0, 0, 1, 1,
    1, 1, 1, 1,
    PERIPHS_IO_MUX_MTDI_U, PERIPHS_IO_MUX_MTCK_U, PERIPHS_IO_MUX_MTMS_U, PERIPHS_IO_MUX_MTDO_U
  };

  switch (type) {
    case WStype_DISCONNECTED:
      Serial.printf("[%u] Disconnected!\n", num);
      break;
    case WStype_CONNECTED:
      {
        IPAddress ip = webSocket.remoteIP(num);
        Serial.printf("[%u] Connected from %d.%d.%d.%d url: %s\n", num, ip[0], ip[1], ip[2], ip[3], payload);
      }
      break;
    case WStype_TEXT:

      // send data to all connected clients
      // webSocket.broadcastTXT("message here");

      switch (payload[0]) {
        case 'w': case 'W':  // Request RSSI wx
          rssi = String(WiFi.RSSI());
          // Serial.printf("[%u] Got message: %s\n", num, payload);
          webSocket.sendTXT(0, rssi);
          break;

        case 'C': // not sure... CVR
          Serial.printf("[%u] Got message: %s\n", num, payload);
          webSocket.sendTXT(0, "");
          break;

        case 'e': case 'E':   //Echo
          webSocket.sendTXT(0, text);
          break;
        case 'G': // GPIO
          {
            Serial.printf("[%u] Got message: %s\n", num, payload);
            int pin = payload[1] - '0';
            int value;
            value = payload[2] - '0';
            pinMode(pin, OUTPUT);
            digitalWrite(pin, value);
            break;
            webSocket.sendTXT(0, b);

          }
          break;

        default:
          webSocket.sendTXT(0, "**** UNDEFINED ****");
          Serial.printf("[%u] Got UNDEFINED message: %s\n", num, payload);
          break;
      }
      break;
  }
  }
  //************ End of WebSocket *****************/

void handleRoot() {
  // Prepare the response. Start with the common header:
  String s = "<!DOCTYPE HTML>\r\n<html>\r\n";
  s += "<head><meta http-equiv=\"content-type\" content=\"text/html; charset=utf-8\"></head>";
  s += " <meta name=\"viewport\" content=\"user-scalable=no, initial-scale=1, maximum-scale=1, minimum-scale=1, width=device-width\">";
  s += " <a href=\"http://main.local\">Home</a>";
  s += "<img src=\"http://yyliao1.github.io/image/ibt1283-1.jpg\" width=\"400\" height=\"490\" usemap=\"#TestMap\">";
  s += "<map name=\"TestMap\">";
  s += "<area shape=\"rect\" coords=\" 13 , 13 , 58 , 53\" href=\"\\TVMute\">";
  s += "<area shape=\"rect\" coords=\" 138 , 18 , 181 , 56\" href=\"\\TVOn\">";
  s += "<area shape=\"rect\" coords=\" 194 , 1 , 244 , 43\" href=\"\\key1\">";
  s += "<area shape\"rect\" coords=\" 271 , 1 , 330 , 43\" href=\"\\key2\">";
  s += "<area shape\"rect\" coords=\" 354 , 1 , 397 , 49\" href=\"\\key3\">";
  s += "<area shape\"rect\" coords=\" 190 , 53 , 243 , 94\" href=\"\\key4\">";
  s += "<area shape\"rect\" coords=\" 267 , 53 , 324 , 97\" href=\"\\key5\">";
  s += "<area shape\"rect\" coords=\" 348 , 58 , 396 , 103\" href=\"\\key6\">";
  s += "<area shape\"rect\" coords=\" 192 , 107 , 239 , 146\" href=\"\\key7\">";
  s += "<area shape\"rect\" coords=\" 269 , 107 , 317 , 150\" href=\"\\key8\">";
  s += "<area shape\"rect\" coords=\" 349 , 107 , 398 , 151\" href=\"\\key9\">";
  s += "<area shape\"rect\" coords=\" 268 , 158 , 315 , 203\" href=\"\\key0\">";

  s += "<area shape\"rect\" coords=\" 58 , 220 , 122 , 249\" href=\"\\keyUp\">";
  s += "<area shape\"rect\" coords=\" 58 , 309 , 117 , 341\" href=\"\\keyDown\">";
  s += "<area shape\"rect\" coords=\" 26 , 248 , 56 , 313\" href=\"\\keyLeft\">";
  s += "<area shape\"rect\" coords=\" 123 , 251 , 147 , 317\" href=\"\\keyRight\">";
  s += "<area shape\"rect\" coords=\" 67 , 258 , 109 , 305\" href=\"\\keyOK\">";

  s += "<area shape\"rect\" coords=\" 135 , 388 , 158 , 434\" href=\"\\keyChUp\">";
  s += "<area shape\"rect\" coords=\" 131 , 432 , 164 , 478\" href=\"\\keyChDown\">";

  s += "</map>";
  s += "<style>td{font-size:xx-large;}</style>";
  s += "<table  style=\"width:100%;\">";
  s += "<tr align=\"center\"><td><a href=\"\\TVPower\"><button>TV On/Off</button></a></td>";
   s += "<tr align=\"center\"><td><a href=\"\\AIRPower\"><button>AIR On/Off</button></a></td>";
  s += "</html>\n";
  server.send(200, "text/html", s);
}

void handleNotFound() {

  String message = "File Not Found\n\n";
  message += "URI: ";
  message += server.uri();
  message += "\nMethod: ";
  message += (server.method() == HTTP_GET) ? "GET" : "POST";
  message += "\nArguments: ";
  message += server.args();
  message += "\n";
  for (uint8_t i = 0; i < server.args(); i++) {
    message += " " + server.argName(i) + ": " + server.arg(i) + "\n";
  }
  server.send(404, "text/plain", message);
}
String formatBytes(size_t bytes) {
  if (bytes < 1024) {
    return String(bytes) + "B";
  } else if (bytes < (1024 * 1024)) {
    return String(bytes / 1024.0) + "KB";
  } else if (bytes < (1024 * 1024 * 1024)) {
    return String(bytes / 1024.0 / 1024.0) + "MB";
  } else {
    return String(bytes / 1024.0 / 1024.0 / 1024.0) + "GB";
  }
}

String getContentType(String filename) {
  if (server.hasArg("download")) return "application/octet-stream";
  else if (filename.endsWith(".htm")) return "text/html";
  else if (filename.endsWith(".html")) return "text/html";
  else if (filename.endsWith(".css")) return "text/css";
  else if (filename.endsWith(".js")) return "application/javascript";
  else if (filename.endsWith(".png")) return "image/png";
  else if (filename.endsWith(".gif")) return "image/gif";
  else if (filename.endsWith(".jpg")) return "image/jpeg";
  else if (filename.endsWith(".ico")) return "image/x-icon";
  else if (filename.endsWith(".xml")) return "text/xml";
  else if (filename.endsWith(".pdf")) return "application/x-pdf";
  else if (filename.endsWith(".zip")) return "application/x-zip";
  else if (filename.endsWith(".gz")) return "application/x-gzip";
  return "text/plain";
}

bool handleFileRead(String path) {
  //  DBG_OUTPUT_PORT.println("handleFileRead: " + path);
  if (path.endsWith("/")) path += "index.htm";
  String contentType = getContentType(path);
  String pathWithGz = path + ".gz";
  if (SPIFFS.exists(pathWithGz) || SPIFFS.exists(path)) {
    if (SPIFFS.exists(pathWithGz))
      path += ".gz";
    File file = SPIFFS.open(path, "r");
    size_t sent = server.streamFile(file, contentType);
    file.close();
    return true;
  }
  return false;
}

void handleFileUpload() {
  if (server.uri() != "/edit") return;
  HTTPUpload& upload = server.upload();
  if (upload.status == UPLOAD_FILE_START) {
    String filename = upload.filename;
    if (!filename.startsWith("/")) filename = "/" + filename;
    //DBG_OUTPUT_PORT.print("handleFileUpload Name: "); DBG_OUTPUT_PORT.println(filename);
    fsUploadFile = SPIFFS.open(filename, "w");
    filename = String();
  } else if (upload.status == UPLOAD_FILE_WRITE) {
    //DBG_OUTPUT_PORT.print("handleFileUpload Data: "); DBG_OUTPUT_PORT.println(upload.currentSize);
    if (fsUploadFile)
      fsUploadFile.write(upload.buf, upload.currentSize);
  } else if (upload.status == UPLOAD_FILE_END) {
    if (fsUploadFile)
      fsUploadFile.close();
    //DBG_OUTPUT_PORT.print("handleFileUpload Size: "); DBG_OUTPUT_PORT.println(upload.totalSize);
  }
}

void handleFileDelete() {
  if (server.args() == 0) return server.send(500, "text/plain", "BAD ARGS");
  String path = server.arg(0);
  //Serial.println("handleFileDelete: " + path);
  if (path == "/")
    return server.send(500, "text/plain", "BAD PATH");
  if (!SPIFFS.exists(path))
    return server.send(404, "text/plain", "FileNotFound");
  SPIFFS.remove(path);
  server.send(200, "text/plain", "");
  path = String();
}

void handleFileCreate() {
  if (server.args() == 0)
    return server.send(500, "text/plain", "BAD ARGS");
  String path = server.arg(0);
  //Serial.println("handleFileCreate: " + path);
  if (path == "/")
    return server.send(500, "text/plain", "BAD PATH");
  if (SPIFFS.exists(path))
    return server.send(500, "text/plain", "FILE EXISTS");
  File file = SPIFFS.open(path, "w");
  if (file)
    file.close();
  else
    return server.send(500, "text/plain", "CREATE FAILED");
  server.send(200, "text/plain", "");
  path = String();
}

void handleFileList() {
  if (!server.hasArg("dir")) {
    server.send(500, "text/plain", "BAD ARGS");
    return;
  }

  String path = server.arg("dir");
  //Serial.println("handleFileList: " + path);
  Dir dir = SPIFFS.openDir(path);
  path = String();

  String output = "[";
  while (dir.next()) {
    File entry = dir.openFile("r");
    if (output != "[") output += ',';
    bool isDir = false;
    output += "{\"type\":\"";
    output += (isDir) ? "dir" : "file";
    output += "\",\"name\":\"";
    output += String(entry.name()).substring(1);
    output += "\"}";
    entry.close();
  }

  output += "]";
  server.send(200, "text/json", output);
}
//***********************Setup*************************
void setup()
{
  Serial.begin(115200);
  irsend.begin();

  //********************File System**************************
  SPIFFS.begin();
  Dir dir = SPIFFS.openDir("/");
  while (dir.next()) {
    String fileName = dir.fileName();
    size_t fileSize = dir.fileSize();
  }
  //*****************************************************
  // **************Wifi ************************
  WiFi.begin(ssid, password);
  WiFi.config(ip, gateway, subnet);
  /* while (WiFi.waitForConnectResult() != WL_CONNECTED) {
     WiFi.begin(ssid, password);
     WiFi.config(ip, gateway, subnet);
     Serial.println("WiFi failed, retrying.");
    }*/
 Serial.print("Connected! IP address: ");
  Serial.println(WiFi.localIP());
  //webSocket.begin();
  //webSocket.onEvent(webSocketEvent);
  server.begin();
  httpUpdater.setup(&server);

  MDNS.begin(host);
  MDNS.addService("http", "tcp", 80);
  
  // Wait for connection
  int i = 0;
  while (WiFi.status() != WL_CONNECTED) {
    delay(500);
    i ++;
    if (i > 5) {
      ESP.deepSleep(30000000, WAKE_RF_DEFAULT); //Deep Sleep
    }
  }
  //***************Web server ***********************************
  server.on("/", handleRoot);
  //list directory
  server.on("/list", HTTP_GET, handleFileList);
  //load editor
  server.on("/edit", HTTP_GET, []() {
    if (!handleFileRead("/edit.htm")) server.send(404, "text/plain", "FileNotFound");
  });
  //create file
  server.on("/edit", HTTP_PUT, handleFileCreate);
  //delete file
  server.on("/edit", HTTP_DELETE, handleFileDelete);
  //first callback is called after the request has ended with all parsed arguments
  //second callback handles file uploads at that location

  server.on("/edit", HTTP_POST, []() {
    server.send(200, "text/plain", "");
  }, handleFileUpload);

  server.onNotFound([]() {
    if (!handleFileRead(server.uri()))
      server.send(404, "text/plain", "FileNotFound");
  });

  server.on("/TVPower", []() {
    //  server.send(200, "text/plain", "this works as well");
    for (int i = 0; i < 3; i++) {
       irsend.sendRaw(sanyoPower, 67, 38);
       delay(50);
        irsend.sendRaw(sanyoPower1, 67, 38);
        delay(50);
    }
    handleRoot();
  });

 server.on("/AIRPower", []() {
    //  server.send(200, "text/plain", "this works as well");
    for (int i = 0; i < 3; i++) {
      irsend.sendRaw(sanyoAIRPower, 99, 38);
       irsend.sendRaw(sanyoAIRPower1, 99, 38);
    }
    handleRoot();
  });

  server.on("/TVMute", []() {
    //  server.send(200, "text/plain", "this works as well");
    for (int i = 0; i < 3; i++) {
      irsend.sendRaw(rawMute, 67, 38);
    }
    handleRoot();
  });

  server.on("/TVOn", []() {
    //   server.send(200, "text/plain", "this works as well");
    for (int i = 0; i < 3; i++) {
      irsend.sendRaw(IBT1283Power, 67, 38);
    }
    handleRoot();
  });

  server.on("/key1", []() {
    for (int i = 0; i < 3; i++) {
      irsend.sendRaw(IBT12831, 67, 38);
    }
    handleRoot();
  });

  server.on("/key2", []() {
    for (int i = 0; i < 3; i++) {
      irsend.sendRaw(IBT12832, 67, 38);
    }
    handleRoot();
  });

  server.on("/key3", []() {
    for (int i = 0; i < 3; i++) {
      irsend.sendRaw(IBT12833, 67, 38);
    }
    handleRoot();
  });

  server.on("/key4", []() {
    for (int i = 0; i < 3; i++) {
      irsend.sendRaw(IBT12834, 67, 38);
    }
    handleRoot();
  });

  server.on("/key5", []() {
    for (int i = 0; i < 3; i++) {
      irsend.sendRaw(IBT12835, 67, 38);
    }
    handleRoot();
  });

  server.on("/key6", []() {
    for (int i = 0; i < 3; i++) {
      irsend.sendRaw(IBT12836, 67, 38);
    }
    handleRoot();
  });

  server.on("/key7", []() {
    for (int i = 0; i < 3; i++) {
      irsend.sendRaw(IBT12837, 67, 38);
    }
    handleRoot();
  });

  server.on("/key8", []() {
    for (int i = 0; i < 3; i++) {
      irsend.sendRaw(IBT12838, 67, 38);
    }
    handleRoot();
  });

  server.on("/key9", []() {
    for (int i = 0; i < 3; i++) {
      irsend.sendRaw(IBT12839, 67, 38);
    }
    handleRoot();
  });

  server.on("/key0", []() {
    for (int i = 0; i < 3; i++) {
      irsend.sendRaw(IBT12830, 67, 38);
    }
    handleRoot();
  });

  server.on("/key10", []() {
    for (int i = 0; i < 3; i++) {
      irsend.sendRaw(IBT128310, 67, 38);
    }
    handleRoot();
  });

  server.on("/key11", []() {
    for (int i = 0; i < 3; i++) {
      irsend.sendRaw(IBT128311, 67, 38);
    }
    handleRoot();
  });

  server.on("/keyUp", []() {
    for (int i = 0; i < 3; i++) {
      irsend.sendRaw(rawUp, 67, 38);
    }
    handleRoot();
  });

  server.on("/keyDown", []() {
    for (int i = 0; i < 3; i++) {
      irsend.sendRaw(rawDown, 67, 38);
    }
    handleRoot();
  });

  server.on("/keyLeft", []() {
    for (int i = 0; i < 3; i++) {
      irsend.sendRaw(rawLeft, 67, 38);
    }
    handleRoot();
  });

  server.on("/keyRight", []() {
    for (int i = 0; i < 3; i++) {
      irsend.sendRaw(rawRight, 67, 38);
    }
    handleRoot();
  });

  server.on("/keyOK", []() {
    for (int i = 0; i < 3; i++) {
      irsend.sendRaw(rawOK, 67, 38);
    }
    handleRoot();
  });

  server.on("/keyChUp", []() {
    for (int i = 0; i < 3; i++) {
      irsend.sendRaw(IBT1283ChanelUp, 67, 38);
    }
    handleRoot();
  });

  server.on("/keyChDown", []() {
    for (int i = 0; i < 3; i++) {
      irsend.sendRaw(IBT1283ChanelDown, 67, 38);
    }
    handleRoot();
  });
  server.onNotFound(handleNotFound);
}
//**********************Loop **************
void loop() {
  server.handleClient();
  //webSocket.loop();

  int i = 0;
  while (WiFi.status() != WL_CONNECTED) {
    delay(500);
    i ++;
    if (i > 5) {
      ESP.deepSleep(30000000, WAKE_RF_DEFAULT);
    }
  }
  //***********Call Deep Sleep DB and Start Deep Sleep ***********
  String url = "http://";
  url += serverIP;
  url += "/deepSelect.php?entity=";
  url += entity;
  // if((WiFiMulti.run() == WL_CONNECTED)) {

  http.begin(url);
  int httpCode = http.GET();
  if (httpCode > 0) {
    if (httpCode == HTTP_CODE_OK) {
      line = http.getString();
      //  Serial.println(line);
      int yy = line[14] - '0';
      if (yy > 0) {
        ESP.deepSleep(20000000, WAKE_RF_DEFAULT);
      }
    }
  } else {
    //Serial.printf("[HTTP] GET... failed, error: %s\n", http.errorToString(httpCode).c_str());
    ESP.deepSleep(30000000, WAKE_RF_DEFAULT);
  }
  http.end();
  //}
  //**********end Check DB for deep sleep *********************
  //delay(50);
}
